/*
 * Copyright (c) 2020 Pete Johanson
 *
 * SPDX-License-Identifier: MIT
 */

#include "glide.dtsi"

&default_transform {
    col-offset = <6>;
};

&kscan0 {
    row-gpios
        = <&xiao_d 1 GPIO_ACTIVE_HIGH>
        , <&xiao_d 2 GPIO_ACTIVE_HIGH>
        , <&xiao_d 0 GPIO_ACTIVE_HIGH>
        , <&xiao_d 6 GPIO_ACTIVE_HIGH>
        ;

    col-gpios
        = <&xiao_d 10 (GPIO_PULL_DOWN | GPIO_ACTIVE_HIGH)>
        , <&xiao_d 3  (GPIO_PULL_DOWN | GPIO_ACTIVE_HIGH)>
        , <&xiao_d 9 (GPIO_PULL_DOWN | GPIO_ACTIVE_HIGH)>
        , <&xiao_d 4  (GPIO_PULL_DOWN | GPIO_ACTIVE_HIGH)>
        , <&xiao_d 7 (GPIO_PULL_DOWN | GPIO_ACTIVE_HIGH)>
        ;

};
