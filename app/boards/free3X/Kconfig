## app/boards/free3X/Kconfig
```kconfig
# SPDX-License-Identifier: MIT

# 启用 nRF52840 的 DC-DC 电源转换器模式。
# DC-DC 比默认的 LDO（线性稳压）效率更高，可显著降低功耗、延长电池续航。
# 对于无线键盘来说这条几乎是必要的，保留。
config BOARD_ENABLE_DCDC
    bool "Enable DCDC mode"
    # 激活 nRF52 系列芯片的 DC-DC 稳压驱动
    select SOC_DCDC_NRF52X
    # 默认开启，无需用户手动打开
    default y
    # 仅在编译 free3X 左手或右手板时生效
    depends on (BOARD_FREE3X_LEFT || BOARD_FREE3X_RIGHT)
```

## app/boards/free3X/Kconfig.defconfig
```kconfig
# SPDX-License-Identifier: MIT

# ── 仅左手板生效的配置 ──────────────────────────────────────
if BOARD_FREE3X_LEFT

# 蓝牙广播和 USB HID 显示的键盘名称
config ZMK_KEYBOARD_NAME
    default "free3X"

# 将左手板设为分体键盘的「主机端」（Central）。
# 主机端负责通过 BLE 收集右手板按键数据，并统一上报给电脑。
# 右手板不写此项，自动成为「外设端」（Peripheral）。
config ZMK_SPLIT_ROLE_CENTRAL
    default y

endif # BOARD_FREE3X_LEFT

# ── 左右手板共用的配置 ──────────────────────────────────────
if BOARD_FREE3X_LEFT || BOARD_FREE3X_RIGHT

# 编译产物统一使用 "free3X" 作为 BOARD 名，便于识别固件归属
config BOARD
    default "free3X"

# 启用 ZMK 分体键盘支持，左右两板通过 BLE 内部通信
config ZMK_SPLIT
    default y

# 启用蓝牙控制器（BT Controller）。
# BT 是 Kconfig 内置符号，跟随 ZMK_BLE 开关自动为 y，这行等于"跟随蓝牙开关"。
config BT_CTLR
    default BT

# 仅当 USB 设备栈被启动时（由 defconfig 里的 CONFIG_ZMK_USB=y 触发），
# 才启用 nRF52 原生 USB 驱动（USB_NRFX）。
if USB_DEVICE_STACK

config USB_NRFX
    default y

endif # USB_DEVICE_STACK

endif # BOARD_FREE3X_LEFT || BOARD_FREE3X_RIGHT
```

## app/boards/free3X/Kconfig.free3X_left
```kconfig
# SPDX-License-Identifier: MIT

# 左手板硬件能力声明文件。
# board.yml 中 name: free3X_left 会自动生成对应的 BOARD_FREE3X_LEFT 符号。
config BOARD_FREE3X_LEFT
    # 指定芯片型号为 nRF52840-QIAA（QFN73 封装，1MB Flash，256KB RAM）
    select SOC_NRF52840_QIAA
    # 声明此板已按 ZMK 规范完整配置（Flash 分区、Bootloader 对接等）。
    # 若缺少此标记，编译时 ZMK 会打印警告。
    # 条件：仅在使用 nrf52840/zmk 变体时生效（即 board.yml 里 variant: zmk）
    select ZMK_BOARD_COMPAT if BOARD_FREE3X_LEFT_NRF52840_ZMK
    # 以下三条启用 Zephyr「保留内存」子系统，用于重启时保留引导模式标志位。
    # 配合 nrf52840_uf2_boot_mode.dtsi，可让 ZMK 通过软件触发进入 UF2 Bootloader 刷机模式
    # （即双击 Reset、或 ZMK 的 &bootloader 按键）。纯按键键盘也需要保留这三条。
    imply RETAINED_MEM if BOARD_FREE3X_LEFT_NRF52840_ZMK
    imply RETENTION if BOARD_FREE3X_LEFT_NRF52840_ZMK
    imply RETENTION_BOOT_MODE if BOARD_FREE3X_LEFT_NRF52840_ZMK
```

## app/boards/free3X/Kconfig.free3X_right
```kconfig
# SPDX-License-Identifier: MIT

# 右手板硬件能力声明文件，结构与左手板完全对称。
config BOARD_FREE3X_RIGHT
    # 同为 nRF52840-QIAA 芯片
    select SOC_NRF52840_QIAA
    # 声明 ZMK 规范适配完整
    select ZMK_BOARD_COMPAT if BOARD_FREE3X_RIGHT_NRF52840_ZMK
    # 保留内存子系统，支持软件触发进入 UF2 刷机模式
    imply RETAINED_MEM if BOARD_FREE3X_RIGHT_NRF52840_ZMK
    imply RETENTION if BOARD_FREE3X_RIGHT_NRF52840_ZMK
    imply RETENTION_BOOT_MODE if BOARD_FREE3X_RIGHT_NRF52840_ZMK
```

## app/boards/free3X/board.yml
```yaml
boards:
  - name: free3X_left
    socs:
      - name: nrf52840
        variants:
          - name: zmk
  - name: free3X_right
    socs:
      - name: nrf52840
        variants:
          - name: zmk
```

## app/boards/free3X/free3X_left_nrf52840_zmk_defconfig
```kconfig
# SPDX-License-Identifier: MIT

# ── 处理器安全 ──────────────────────────────────────────────
# 启用 ARM 内存保护单元（MPU），防止固件越界访问内存。
# 是 nRF52840 的基础安全配置，必须保留。
CONFIG_ARM_MPU=y

# ── 引脚控制 ────────────────────────────────────────────────
# 启用 Zephyr pinctrl 子系统，用于在 DTS 中声明引脚复用。
# nRF52840 的 nrfx 底层驱动内部依赖 pinctrl，删除后编译会报错，必须保留。
CONFIG_PINCTRL=y

# ── GPIO ────────────────────────────────────────────────────
# 启用 GPIO 驱动。键盘矩阵扫描直接依赖 GPIO，必须保留。
CONFIG_GPIO=y

# ── Flash 分区与固件格式 ─────────────────────────────────────
# 让固件从 DTS code_partition 起始地址加载，而不是 Flash 地址 0。
# 这样固件不会覆盖 Bootloader 区域，必须保留。
CONFIG_USE_DT_CODE_PARTITION=y
# 编译额外生成 .uf2 文件，可直接拖入 UF2 Bootloader 虚拟 U 盘刷机，必须保留。
CONFIG_BUILD_OUTPUT_UF2=y

# ── 键盘设置持久化（蓝牙配对、层状态等）───────────────────────
# 允许受 MPU 保护的代码写入 Flash（存储配对信息等），必须保留。
CONFIG_MPU_ALLOW_FLASH_WRITE=y
# 启用 NVS（Non-Volatile Storage）Flash 存储，ZMK 用它保存蓝牙绑定，必须保留。
CONFIG_NVS=y
# 使用 NVS 作为 Zephyr Settings 子系统的后端，ZMK 所有持久化配置依赖此项，必须保留。
CONFIG_SETTINGS_NVS=y
# Flash 设备驱动，NVS 的依赖项，必须保留。
CONFIG_FLASH=y
# Flash 分页布局支持（擦写操作需要），必须保留。
CONFIG_FLASH_PAGE_LAYOUT=y
# Flash 分区映射，用于解析 DTS 里的 partitions 节点，必须保留。
CONFIG_FLASH_MAP=y

# ── 输出接口 ────────────────────────────────────────────────
# 启用 USB HID 输出。左手板有 USB 口，插线时作为有线键盘使用，必须保留。
CONFIG_ZMK_USB=y
# 启用蓝牙 HID 输出（BLE HID over GATT），无线模式使用，必须保留。
CONFIG_ZMK_BLE=y
# 关闭 BLE 2M PHY，提升与 Win11 主机的兼容性。
CONFIG_BT_CTLR_PHY_2M=n
```

## app/boards/free3X/free3X_right_nrf52840_zmk_defconfig
```kconfig
# SPDX-License-Identifier: MIT

# ── 处理器安全 ──────────────────────────────────────────────
# 启用 ARM MPU，nRF52840 基础安全配置，必须保留。
CONFIG_ARM_MPU=y

# ── 引脚控制 ────────────────────────────────────────────────
# nrfx 驱动依赖，必须保留。
CONFIG_PINCTRL=y

# ── GPIO ────────────────────────────────────────────────────
# 键盘矩阵扫描依赖，必须保留。
CONFIG_GPIO=y

# ── Flash 分区与固件格式 ─────────────────────────────────────
# 从 DTS code_partition 加载，避免覆盖 Bootloader，必须保留。
CONFIG_USE_DT_CODE_PARTITION=y
# 生成 .uf2 可拖拽刷机文件，必须保留。
CONFIG_BUILD_OUTPUT_UF2=y

# ── 键盘设置持久化 ───────────────────────────────────────────
# 右手板是外设端（Peripheral），不直接连接电脑，但同样需要存储蓝牙绑定信息，以下均保留。
CONFIG_MPU_ALLOW_FLASH_WRITE=y
CONFIG_NVS=y
CONFIG_SETTINGS_NVS=y
CONFIG_FLASH=y
CONFIG_FLASH_PAGE_LAYOUT=y
CONFIG_FLASH_MAP=y

# ── 输出接口 ────────────────────────────────────────────────
# 【可删除】右手板是分体外设端，只和左手板（Central）通过 BLE 内部通信，
# 不直接连接电脑，不走 USB HID 流程。
# ZMK Kconfig 里 ZMK_USB 本身 depends on ZMK_SPLIT_ROLE_CENTRAL，
# 右手板不设 CENTRAL，所以此行实际上不生效（被 Kconfig 依赖关系静默忽略），
# 可以删除以保持配置整洁，但留着也不会出错。
CONFIG_ZMK_USB=y
# 启用蓝牙，右手板通过 BLE 与左手板通信，必须保留。
CONFIG_ZMK_BLE=y
```

## app/boards/shiduo3400/Kconfig
```kconfig
# SPDX-License-Identifier: MIT

# 启用 nRF52840 的 DC-DC 电源转换器模式，降低功耗、延长电池续航，保留。
config BOARD_ENABLE_DCDC
    bool "Enable DCDC mode"
    # 激活 nRF52 系列芯片的 DC-DC 稳压驱动
    select SOC_DCDC_NRF52X
    # 默认开启
    default y
    # 仅在编译 shiduo3400 时生效
    depends on BOARD_SHIDUO3400
```

## app/boards/shiduo3400/Kconfig.defconfig
```kconfig
# SPDX-License-Identifier: MIT

if BOARD_SHIDUO3400

# 蓝牙广播和 USB HID 显示的键盘名称
config ZMK_KEYBOARD_NAME
    default "shiduo3400"

# 仅当 USB 设备栈被启动时（由 defconfig 里的 CONFIG_ZMK_USB=y 触发），
# 才启用 nRF52 原生 USB 驱动（USB_NRFX）。
if USB_DEVICE_STACK

config USB_NRFX
    default y

endif # USB_DEVICE_STACK

# 启用蓝牙控制器。BT 符号跟随 ZMK_BLE 开关，这行等于"跟随蓝牙开关"。
config BT_CTLR
    default BT

endif # BOARD_SHIDUO3400
```

## app/boards/shiduo3400/Kconfig.shiduo3400
```kconfig
# SPDX-License-Identifier: MIT

# shiduo3400 硬件能力声明。
# board.yml 中 name: shiduo3400 会自动生成对应的 BOARD_SHIDUO3400 符号。
config BOARD_SHIDUO3400
    # 指定芯片型号为 nRF52840-QIAA（QFN73 封装，1MB Flash，256KB RAM）
    select SOC_NRF52840_QIAA
    # 声明此板已按 ZMK 规范完整配置（Flash 分区、Bootloader 对接等）。
    # 条件：仅在使用 nrf52840/zmk 变体时生效
    select ZMK_BOARD_COMPAT if BOARD_SHIDUO3400_NRF52840_ZMK
    # 以下三条启用「保留内存」子系统，配合 nrf52840_uf2_boot_mode.dtsi，
    # 支持软件触发进入 UF2 Bootloader 刷机模式（&bootloader 按键 / 双击 Reset）。
    # 纯按键键盘也需要保留这三条。
    imply RETAINED_MEM if BOARD_SHIDUO3400_NRF52840_ZMK
    imply RETENTION if BOARD_SHIDUO3400_NRF52840_ZMK
    imply RETENTION_BOOT_MODE if BOARD_SHIDUO3400_NRF52840_ZMK
```

## app/boards/shiduo3400/board.yml
```yaml
board:
  name: shiduo3400
  socs:
    - name: nrf52840
      variants:
        - name: zmk
```

## app/boards/shiduo3400/shiduo3400_nrf52840_zmk_defconfig
```kconfig
# SPDX-License-Identifier: MIT

# ── 处理器安全 ──────────────────────────────────────────────
# 启用 ARM 内存保护单元（MPU），nRF52840 基础安全配置，必须保留。
CONFIG_ARM_MPU=y

# ── 引脚控制 ────────────────────────────────────────────────
# nRF52840 的 nrfx 底层驱动内部依赖 pinctrl，必须保留。
CONFIG_PINCTRL=y

# ── GPIO ────────────────────────────────────────────────────
# 启用 GPIO 驱动，键盘矩阵扫描直接依赖，必须保留。
CONFIG_GPIO=y

# ── Flash 分区与固件格式 ─────────────────────────────────────
# 从 DTS code_partition 起始地址加载固件，不覆盖 Bootloader 区域，必须保留。
CONFIG_USE_DT_CODE_PARTITION=y
# 生成 .uf2 文件，可直接拖入 UF2 Bootloader 虚拟 U 盘刷机，必须保留。
CONFIG_BUILD_OUTPUT_UF2=y

# ── 键盘设置持久化（蓝牙配对信息等）─────────────────────────
# 允许 MPU 保护下的代码写 Flash（存储配对信息），必须保留。
CONFIG_MPU_ALLOW_FLASH_WRITE=y
# NVS Flash 存储，ZMK 用于保存蓝牙绑定，必须保留。
CONFIG_NVS=y
# 使用 NVS 作为 Settings 后端，ZMK 所有持久化配置依赖此项，必须保留。
CONFIG_SETTINGS_NVS=y
# Flash 设备驱动，NVS 的依赖项，必须保留。
CONFIG_FLASH=y
# Flash 分页布局支持（擦写操作需要），必须保留。
CONFIG_FLASH_PAGE_LAYOUT=y
# Flash 分区映射，解析 DTS 的 partitions 节点，必须保留。
CONFIG_FLASH_MAP=y

# ── 输出接口 ────────────────────────────────────────────────
# 启用 USB HID 输出，插线时作为有线键盘使用，必须保留。
CONFIG_ZMK_USB=y
# 启用蓝牙 HID 输出（BLE HID over GATT），无线模式使用，必须保留。
CONFIG_ZMK_BLE=y
```

## app/boards/shields/glide/Kconfig.defconfig
```kconfig
# ── 仅左手 Shield 生效的配置 ────────────────────────────────
if SHIELD_GLIDE_LEFT

# 蓝牙广播和 USB HID 显示的键盘名称
config ZMK_KEYBOARD_NAME
    default "Glide"

# 将左手 Shield 设为分体键盘的「主机端」（Central）。
# 主机端汇总右手按键数据并上报给电脑；右手 Shield 不写此项，自动成为外设端。
config ZMK_SPLIT_ROLE_CENTRAL
    default y

endif

# ── 左右手 Shield 共用的配置 ─────────────────────────────────
if SHIELD_GLIDE_LEFT || SHIELD_GLIDE_RIGHT

# 启用 ZMK 分体键盘支持，左右两边通过 BLE 内部通信。
# 注意：Glide 是 Shield（扩展板），底板（如 xiao_ble）的 defconfig 提供
# PINCTRL、GPIO、FLASH 等基础驱动，Shield 这里只需声明 ZMK 层面的分体功能。
config ZMK_SPLIT
    default y

endif
```

## app/boards/shields/glide/Kconfig.shield
```kconfig
# Copyright (c) 2020 Pete Johanson
# SPDX-License-Identifier: MIT

# Shield 自动检测：通过检查编译命令 -DSHIELD= 传入的列表来判断当前编译的是哪半边。
# def_bool 表示"由构建系统自动推导，不在 menuconfig 中显示"。

# 当 -DSHIELD=glide_left 时，此符号为 y，否则为 n
config SHIELD_GLIDE_LEFT
    def_bool $(shields_list_contains,glide_left)

# 当 -DSHIELD=glide_right 时，此符号为 y，否则为 n
config SHIELD_GLIDE_RIGHT
    def_bool $(shields_list_contains,glide_right)
```

## v0.3/zmk-config-free3X/boards/arm/free3X/Kconfig.board
```kconfig
# SPDX-License-Identifier: MIT

config BOARD_FREE3X_LEFT
	bool "free3X_left"
	depends on SOC_NRF52840_QIAA

config BOARD_FREE3X_RIGHT
	bool "free3X_right"
	depends on SOC_NRF52840_QIAA
```

## v0.3/zmk-config-free3X/boards/arm/free3X/Kconfig.defconfig
```kconfig
# SPDX-License-Identifier: MIT

if BOARD_FREE3X_LEFT || BOARD_FREE3X_RIGHT

config BOARD
	default "free3X"

config ZMK_KEYBOARD_NAME
	default "free3X"

config ZMK_SPLIT
	default y

if BOARD_FREE3X_LEFT

config ZMK_SPLIT_ROLE_CENTRAL
    default y

endif # BOARD_FREE3X_LEFT

if USB_DEVICE_STACK

config USB_NRFX
    default y

endif # USB_DEVICE_STACK

config BT_CTLR
	default BT

endif # BOARD_FREE3X_LEFT || BOARD_FREE3X_RIGHT
```

## v0.3/zmk-config-shiduo3400/boards/arm/shiduo3400/Kconfig.board
```kconfig
# SPDX-License-Identifier: MIT

config BOARD_SHIDUO3400
	bool "shiduo3400"
	depends on SOC_NRF52840_QIAA
```

## v0.3/zmk-config-shiduo3400/boards/arm/shiduo3400/Kconfig.defconfig
```kconfig
# SPDX-License-Identifier: MIT

if BOARD_SHIDUO3400

config ZMK_KEYBOARD_NAME
	default "shiduo3400"

if USB_DEVICE_STACK

config USB_NRFX
    default y

endif # USB_DEVICE_STACK

config BT_CTLR
	default BT

endif # BOARD_SHIDUO3400
```
